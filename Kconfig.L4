## Kconfig.L4
```kconfig
menu "Ixl"

config IXL_NDEBUG
    bool "Build Ixl in Release Mode"
    help
        Builds a production version of the Ixl driver library, missing
        debugging output.

config IXL_JEMALLOC
    bool "Use jemalloc as memory allocator for Ixl"
    default n
    help
        Instruct the build system to link the driver library against jemalloc
        instead of L4Re's standard memory allocator.

endmenu
```
